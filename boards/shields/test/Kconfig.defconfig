## boards/shields/test/Kconfig.defconfig
```kconfig
if SHIELD_TEST

config ZMK_KEYBOARD_NAME
    default "corne_left"

config ZMK_SPLIT
    default y

endif
```

## boards/shields/test_left/Kconfig.defconfig
```kconfig
if SHIELD_TEST_LEFT

config ZMK_KEYBOARD_NAME
    default "test_left"

config ZMK_SPLIT
    default y

config ZMK_SPLIT_ROLE_CENTRAL
    default n

endif
```
